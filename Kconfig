## Kconfig
```kconfig
#
# For a description of the syntax of this configuration file,
# see Documentation/kbuild/kconfig-language.txt.
#
mainmenu "Cleanflight/$TARGET $VERSION Firmware Configuration"

source "src/main/Kconfig"
```

## src/main/Kconfig
```kconfig
#
# For a description of the syntax of this configuration file,
# see Documentation/kbuild/kconfig-language.txt.
#
config BOARD
	string
	option env="BOARD"

source "board/Kconfig"

source "board/$BOARD/Kconfig"

config FLASH_SIZE
	int "Flash Size (KiB)"
	default 64 if HAS_FLASH_SIZE64
	default 128 if HAS_FLASH_SIZE128
	default 256 if HAS_FLASH_SIZE256
	help
	  The flash size in KiB. Some variants may have more.

source "drivers/Kconfig"

source "rx/Kconfig"

source "io/Kconfig"

source "telemetry/Kconfig"

source "blackbox/Kconfig"

source "osd/Kconfig"

#source "common/Kconfig"
#source "fc/Kconfig"
```

## src/main/blackbox/Kconfig
```kconfig
config BLACKBOX
	bool "Enable Blackbox flight recorder"
	default y
	depends on HAS_BLACKBOX
	help
	  Blah.
```

## src/main/board/Kconfig
```kconfig
config	HAS_GYRO
	bool
	help
	  Supports a MEMS Gyro.


config	HAS_ACC
	bool
	help
	  supports Accelerometers.

config	HAS_BARO
	bool
	help
	  Supports Barometers.

config	HAS_MAG
	bool
	help
	  Supports Magnetic Compass.

config	HAS_BEEPER
	bool
	help
	  Supports a beeper.

config	HAS_SONAR
	bool
	help
	  Supports a sonar.


config	HAS_UART2
	bool
	help
	  Supports UART2.

config	HAS_UART3
	bool
	help
	  Supports blah.

config	HAS_SOFTSERIAL1
	bool
	help
	  Supports blah.

config	HAS_SOFTSERIAL2
	bool
	help
	  Supports blah.

config	HAS_LED_STRIP
	bool
	help
	  Supports blah.

config	HAS_GPS
	bool
	help
	  Supports blah.

config	HAS_BLACKBOX
	bool
	help
	  Supports blah.

config	HAS_TELEMETRY
	bool
	help
	  Supports blah.

config	HAS_SERIAL_RX
	bool
	help
	  Supports blah.

config	HAS_SERVOS
	bool
	help
	  Supports blah.

config	HAS_DISPLAY
	bool
	help
	  Supports blah.

config	HAS_CLI
	bool
	help
	  Supports blah.

config	HAS_SPEKTRUM_BIND
	bool
	help
	  Supports blah.

config	HAS_SERIAL_4WAY_BLHELI_INTERFACE
	bool
	help
	  Supports blah.

config	HAS_HARDWARE_BIND_PLUG
	bool
	help
	  Supports blah.

config	CPU_STM32F10X
	bool
	help
	  Supports blah.

config	CPU_STM32F10X_MD
	bool
	help
	  Supports blah.

config	HAS_FLASH_SIZE128
	bool
	help
	  Supports blah.

	
```

## src/main/board/NAZE/Kconfig
```kconfig
config NAZE
        bool
        default y
	select HAS_GYRO
	select HAS_ACC
	select HAS_BARO
	select HAS_MAG
	select HAS_BEEPER
	select HAS_SONAR
	select HAS_UART1
	select HAS_UART2
	select HAS_UART3
	select HAS_SOFTSERIAL1
	select HAS_SOFTSERIAL2
	select HAS_LED_STRIP
	select HAS_GPS
	select HAS_BLACKBOX
	select HAS_TELEMETRY
	select HAS_SERVOS
	select HAS_DISPLAY
	select HAS_CLI
	select HAS_SPEKTRUM_BIND
	select HAS_SERIAL_RX
	select HAS_SERIAL_4WAY_BLHELI_INTERFACE
	select HAS_HARDWARE_BIND_PLUG
	select CPU_STM32F10X
	select CPU_STM32F10X_MD
	select HAS_FLASH_SIZE128
	select HAS_MPU6500  #ACC & GYRO
	select HAS_MPU3050
	select HAS_MPU6050
	select HAS_ADXL345
	select HAS_BMA280
	select HAS_MS5611
	select HAS_BMP085
	select HAS_BMP280
	select HAS_HMC5883
	help
	  NAZE32 blah help.



menu "System Type"

#
# The "ARM system type" choice list is ordered alphabetically by option
# text.  Please add new entries in the option alphabetic order.
#
choice
        prompt "NAZE system type"
        default TARGET_NAZE

config	TARGET_NAZE
	bool "Naze32 Acro board"
	select HAS_VOLTAGE_DIVIDER
	select HAS_GTUNE
	help
	  This is a blah...

config	TARGET_ALIENFLIGHT
	bool "ALIEN F1 board"
	help
	  This is another blah...

endchoice

endmenu
```

## src/main/board/NAZE/configs/alienf1_defconfig
```kconfig
/*
 * This file is part of Cleanflight.
 *
 * Cleanflight is free software: you can redistribute it and/or modify
 * it under the terms of the GNU General Public License as published by
 * the Free Software Foundation, either version 3 of the License, or
 * (at your option) any later version.
 *
 * Cleanflight is distributed in the hope that it will be useful,
 * but WITHOUT ANY WARRANTY; without even the implied warranty of
 * MERCHANTABILITY or FITNESS FOR A PARTICULAR PURPOSE.  See the
 * GNU General Public License for more details.
 *
 * You should have received a copy of the GNU General Public License
 * along with Cleanflight.  If not, see <http://www.gnu.org/licenses/>.
 */
CONFIG_TARGET_ALIENFLIGHT=y
CONFIG_TARGET_BOARD_IDENTIFIER="AFF1"
CONFIG_GYRO=y
CONFIG_ACC=y
CONFIG_BARO=y
CONFIG_MAG=y
CONFIG_BEEPER=y
CONFIG_SONAR=y
CONFIG_USE_UART1=y
CONFIG_USE_UART2=y
CONFIG_USE_UART3=y
CONFIG_USE_SOFTSERIAL1=y
CONFIG_USE_SOFTSERIAL2=y
CONFIG_LED_STRIP=y
CONFIG_GPS=y
CONFIG_BLACKBOX=y
CONFIG_CONFIG_TELEMETRY=y
CONFIG_SERIAL_RX=y
CONFIG_USE_SERVOS=y
CONFIG_USE_CLI=y
CONFIG_SPEKTRUM_BIND=y
CONFIG_USE_SERIAL_4WAY_BLHELI_INTERFACE=y
CONFIG_DEFAULT_RX_FEATURE FEATURE_RX_SERIAL=y
CONFIG_DEFAULT FEATURES FEATURE_MOTOR_STOP=y
CONFIG_HARDWARE_BIND_PLUG=y
```

## src/main/board/NAZE/configs/naze_defconfig
```kconfig
CONFIG_TARGET_NAZE=y
CONFIG_TARGET_BOARD_IDENTIFIER="NAZE"
CONFIG_GYRO=y
CONFIG_ACC=y
CONFIG_BARO=y
CONFIG_MAG=y
CONFIG_BEEPER=y
CONFIG_SONAR=y
CONFIG_USE_UART1=y
CONFIG_USE_UART2=y
CONFIG_USE_UART3=y
CONFIG_USE_SOFTSERIAL1=y
CONFIG_USE_SOFTSERIAL2=y
CONFIG_LED_STRIP=y
CONFIG_GPS=y
CONFIG_GTUNE=y
CONFIG_BLACKBOX=y
CONFIG_CONFIG_TELEMETRY=y
CONFIG_SERIAL_RX=y
CONFIG_USE_SERVOS=y
CONFIG_USE_CLI=y
CONFIG_SPEKTRUM_BIND=y
CONFIG_USE_SERIAL_4WAY_BLHELI_INTERFACE=y
CONFIG_HAS_VOLTAGE_DIVIDER=y
CONFIG_DEFAULT_RX_FEATURE FEATURE_RX_SERIAL=y
CONFIG_DEFAULT FEATURES FEATURE_MOTOR_STOP=y
CONFIG_HARDWARE_BIND_PLUG=y
```

## src/main/drivers/Kconfig
```kconfig
menu "Device Drivers"

comment "Drivers for the sensors and orther features"

config HAS_MPU6500
	bool
	help
		ACC & GYRO.

config HAS_MPU3050
	bool
	
config HAS_MPU6050
	bool
	
config HAS_ADXL345
	bool
	
config HAS_BMA280
	bool

config HAS_MS5611
	bool
	
config HAS_BMP085
	bool
	
config HAS_BMP280
	bool

config HAS_HMC5883
	bool


if HAS_ACC

menuconfig	ACC
	bool  "Accelerometers"
	default y
	help
	   Enable support for the Accelerometers.

if ACC

config	ACC_ADXL345
	bool "Use accelerometer feature of ADXL345"
	default y
	depends on HAS_ADXL345
	help
	  Use accelerometer feature of ADXL345.

config	ACC_BMA280
	bool "Use accelerometer feature of BMA280"
	default y
	depends on HAS_BMA280
	help
	  Use accelerometer feature of BMA280.

config	ACC_MMA8452
	bool "Use accelerometer feature of MMA8452"
	default y
	depends on HAS_MMA8452
	help
	  Use accelerometer feature of MMA8452.  

config	ACC_MPU6050
	bool "Use accelerometer feature of MPU6050"
	default y
	depends on HAS_MPU6050
	help
	  Use accelerometer feature of MPU6050.

config	ACC_MPU6500
	bool "Use  accelerometer feature of MPU6500"
	default y
	depends on HAS_MPU6500
	help
	  Use MPU65000 accelerometers

endif

endif # has acc

if HAS_BARO

menuconfig	BARO
	bool  "Barometers, Altimeters"
	default y
	help
	   Enable support for the Barometric Altimeter.

if BARO

config	BARO_BMP085
	bool "Use baro feature of BMP085"
	default y if (NAZE || EUSTM32F103RC || STM32F3DISCOVERY || OLIMEXINO || IRCFUSIONF3 || CC3D)
	depends on HAS_BMP085
	help
	  Use baro feature of BMP085.

config	BARO_BMP280
	bool "Use baro feature of BMP280"
	default y if (NAZE || RMDO || SPRACINGF3EVO || SPRACINGF3MINI)
	depends on HAS_BMP280
	help
	  Use baro feature of BMP280.
	  
config	BARO_MS5611
	bool "Use baro feature of MS5611"
	default y
	depends on HAS_MS5611
	help
	  Use baro feature of MS5611.

endif
endif # has baro

if HAS_GYRO

menuconfig	GYRO
	bool  "Gyroscopes"
	default y
	help
	   Enable support for Gyroscopes.

if GYRO

config	GYRO_MPU6050
	bool "Use gyro feature of MPU6050"
	default y
	depends on HAS_MPU6050
	help
	  Use gyro feature of MPU6050.
	  
config	GYRO_MPU6500
	bool "Use gyro feature of MPU6500"
	default y
	depends on HAS_MPU6000
	help
	  Use gyro feature of MPU6000.
	  
config	GYRO_MPU3050
	bool "Use gyro feature of MPU3050"
	default y
	depends on HAS_MPU3050
	help
	  Use gyro feature of MPU3050.

config	GYRO_BMP085
	bool "BMP085"
	help
	  Blah.

endif

endif # has gyro

if HAS_MAG

menuconfig	MAG
	bool  "Magnetometers, Compass"
	default y
	help
	   Enable support for the Magnetic Compass.

if MAG

config	MAG_BMP085
	bool "BMP085"
	help
	  Blah.

endif

endif # has mag

if HAS_SONAR

menuconfig	SONAR
	bool  "Sonar"
	default y
	help
	   Enable support for the Magnetic Compass.

if SONAR

config	SONAR_HCSR04
	bool "HCSR04"
	help
	  Blah.

endif

endif # has mag

endmenu
```

## src/main/io/Kconfig
```kconfig
menu "Motor Type"

comment "Motor type and settings"

choice
	prompt "Motors"
	default BRUSHLESS_MOTORS

config	BRUSHED_MOTORS
	bool "Brushed"
	help
	  Brushed motors.

config	BRUSHLESS_MOTORS
	bool "Brushless"
	help
	  Brushless motors.

endchoice

config	MIN_THROTTLE
	int "Minimal Throttle value for ESC"
	default 1150
	help
	  Blah would be welcome.

config	MAX_THROTTLE
	int "Maximal Throttle value for ESC"
	default 1850
	help
	  Blah would be welcome.
	  These are AFAIK defaults for SimonK.

config	MIN_COMMAND
	int "Minimal RX Command"
	default 1000
	help
	  Blah would be welcome.

config	CERVO_CENTER_PULSE
	int "Center Pulse"
	default 1500
	help
	  Blah would be welcome.

config	DEFAULT_PWM_RATE
	int "Default PWM Rate for ESCs"
	default 16000 if BRUSHED_MOTORS
	default 400 if BRUSHLESS_MOTORS
	help
	  Blah would be welcome.

endmenu



menuconfig IO_PERIPH
        bool    "Drone I/Os and Peripherals"
        help
	  Blah.

if IO_PERIPH

config	BEEPER
	bool "Beeper for Batt Alarm or Locator"
	depends on HAS_BEEPER
	default y
	help
	  Select if you wish to connect a beeper.

config	DISPLAY
	bool "Configuration Display"
	depends on HAS_DISPLAY
	help
	  Select if you wish to connect Display.

config	TRANSPONDER
	bool "Infrared Transponder for Racing"
	help
	  Select if you wish to hook an IR interface
	  for the Race transponder.

config	GIMBAL
	bool "Gimbal Assembly driver"
	help
	  Select if you wish to drive a Gimbal.

config	GPS
	bool "Global Positionning System"
	depends on HAS_GPS
	help
	  Select if you wish to connect to a GPS.

config	LED_STRIP
	bool "LED Strip Control"
	depends on HAS_LED_STRIP
	help
	  Select if you wish to connect to Led Strip.
	  Supported brands blah...

config	SERIAL_4WAY_BLHELI_INTERFACE
        bool "4Way BLHeli Interface"
        depends on HAS_SERIAL_4WAY_BLHELI_INTERFACE 
        help
          Select if you wish to connect i4Way BLHeli.

config	SERVOS
	bool "Use Servos (other than ESC)"
	depends on HAS_SERVOS
	help
	  Select if you have servos connected.

endif
```

## src/main/osd/Kconfig
```kconfig
config OSD
	bool "On Screen Display"
	default n
	help
	  Enable if your setup hav an OSD board....blah.
```

## src/main/rx/Kconfig
```kconfig
menu 	"Receiver Configuration"


choice
	prompt "Select you receiver type"
	default	SBUS


config	CPPM
	bool "CPPM/PWM"
	help
	  CPPM, Parallel PWM.

config	XBUS
	bool "XBUS"
	depends on HAS_SERIAL_RX
	select SERIALRX
	help
	  Blah.

config	SBUS
	bool "SBUS"
	depends on HAS_SERIAL_RX
	select SERIALRX
	help
	  Blah.

config	SRXL
	bool "SRXL"
	depends on HAS_SERIAL_RX
	select SERIALRX
	help
	  Blah.

config	IBUS
	bool "IBUS"
	depends on HAS_SERIAL_RX
	select SERIALRX
	help
	  Driver for IBUS (Flysky) receiver.

config	SPEKTRUM_BIND
	bool "SPEKTRUM"
	depends on HAS_SPEKTRUM_BIND
	depends on HAS_SERIAL_RX
	select SERIALRX
	help
	  Driver for spektrum satellite receiver.

endchoice
endmenu
```

## src/main/telemetry/Kconfig
```kconfig
menuconfig TELEMETRY
	bool	"Support for Telemetry"
	help
	  Whether the flight controller shall transmit measurements
	  to the RadioCommand.
	  Typically the Battery voltage (VFAS) or the ALTitude.

if TELEMETRY

config TELEMETRY_HOTT
	bool "Support for GRAUPNER Hott"
	help
	  Blah help for hott.

if TELEMETRY_HOTT

config TELEMETRY_HOTT_DEBUG
	bool "Enable Debug output for Hott"
	help
	  Blah debug output or Hott.

endif # HOTT

config TELEMETRY_FRSKY
	bool "Support for FrSKY Telemetry"
	help
	  SXR will use SmartPort, but other receivers like "Blah"
	  Will require this protocol.

config TELEMETRY_SMARTPORT
	bool "Support for SmartPort"
	help
	  SXR will use SmartPort. Blah...

config TELEMETRY_MAVLINK
	bool "Support for MAVLINK Telemetry"
	depends on MAVLINK
	help
	  Blah...

config TELEMETRY_LTM
	bool "Support for LTM"
	help
	  LightTelemetry from KipK
	  Minimal one way telemetry protocol for really bitrates (1200/2400 bauds).
	  Effective for ground OSD, groundstation HUD and Antenna tracker
	  http://www.wedontneednasa.com/2014/02/lighttelemetry-v2-en-route-to-ground-osd.html
 	  This implementation is for LTM v2 > 2400 baud rates.

endif # TELEMETRY
```
